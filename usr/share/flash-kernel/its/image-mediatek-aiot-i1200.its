## usr/share/flash-kernel/its/image-mediatek-aiot-i500.its
```
/dts-v1/;

/ {
        description = "U-Boot fitImage for Mediatek AIoT i500 boards";
        #address-cells = <1>;

        images {
                kernel-1 {
                        description = "Linux kernel";
                        data = /incbin/("@@LINUX_IMAGE_FILE@@");
                        type = "kernel";
                        arch = "arm64";
                        os = "linux";
                        compression = "gzip";
                        load = <0x40200000>;
                        entry = <0x40200000>;
                        hash-1 {
                                algo = "sha256";
                        };
                };
                ramdisk-1 {
                        description = "Ubuntu ramdisk";
                        data = /incbin/("@@INITRD_FILE@@");
                        type = "ramdisk";
                        arch = "arm64";
                        os = "linux";
                        compression = "none";
                        hash-1 {
                                algo = "sha256";
                        };
                };
                fdt-mt8183-pumpkin.dtb {
                        description = "i500 flattened device tree blob";
                        data = /incbin/("/lib/firmware/@@KERNEL_VERSION@@/device-tree/mediatek/mt8183-pumpkin.dtb");
                        type = "flat_dt";
                        arch = "arm64";
                        compression = "none";
                        load = <0x44000000>;
                        hash-1 {
                                algo = "sha256";
                        };
                };
                fdt-camera-ap1302-ar0144-dual.dtbo {
                        description = "camera-ap1302-ar0144-dual tree blob";
                        data = /incbin/("/lib/firmware/@@KERNEL_VERSION@@/device-tree/mediatek/camera-ap1302-ar0144-dual.dtbo");
                        type = "flat_dt";
                        arch = "arm64";
                        compression = "none";
                        load = <0x44c00000>;
                        hash-1 {
                                algo = "sha256";
                        };
                };
                fdt-camera-ap1302-ar0144-single.dtbo {
                        description = "camera-ap1302-ar0144-single tree blob";
                        data = /incbin/("/lib/firmware/@@KERNEL_VERSION@@/device-tree/mediatek/camera-ap1302-ar0144-single.dtbo");
                        type = "flat_dt";
                        arch = "arm64";
                        compression = "none";
                        load = <0x44c00000>;
                        hash-1 {
                                algo = "sha256";
                        };
                };
                fdt-camera-ap1302-ar0330-dual-ar0144-dual.dtbo {
                        description = "camera-ap1302-ar0330-dual-ar0144-dual tree blob";
                        data = /incbin/("/lib/firmware/@@KERNEL_VERSION@@/device-tree/mediatek/camera-ap1302-ar0330-dual-ar0144-dual.dtbo");
                        type = "flat_dt";
                        arch = "arm64";
                        compression = "none";
                        load = <0x44c00000>;
                        hash-1 {
                                algo = "sha256";
                        };
                };
                fdt-camera-ap1302-ar0330-single-ar0144-dual.dtbo {
                        description = "camera-ap1302-ar0330-single-ar0144-dual tree blob";
                        data = /incbin/("/lib/firmware/@@KERNEL_VERSION@@/device-tree/mediatek/camera-ap1302-ar0330-single-ar0144-dual.dtbo");
                        type = "flat_dt";
                        arch = "arm64";
                        compression = "none";
                        load = <0x44c00000>;
                        hash-1 {
                                algo = "sha256";
                        };
                };
                fdt-camera-ap1302-ar0330-single-ar0144-single.dtbo {
                        description = "camera-ap1302-ar0330-single-ar0144-single tree blob";
                        data = /incbin/("/lib/firmware/@@KERNEL_VERSION@@/device-tree/mediatek/camera-ap1302-ar0330-single-ar0144-single.dtbo");
                        type = "flat_dt";
                        arch = "arm64";
                        compression = "none";
                        load = <0x44c00000>;
                        hash-1 {
                                algo = "sha256";
                        };
                };
                fdt-camera-ap1302-ar0330-single.dtbo {
                        description = "camera-ap1302-ar0330-single tree blob";
                        data = /incbin/("/lib/firmware/@@KERNEL_VERSION@@/device-tree/mediatek/camera-ap1302-ar0330-single.dtbo");
                        type = "flat_dt";
                        arch = "arm64";
                        compression = "none";
                        load = <0x44c00000>;
                        hash-1 {
                                algo = "sha256";
                        };
                };
                fdt-camera-ap1302-ar1335-single.dtbo {
                        description = "camera-ap1302-ar1335-single tree blob";
                        data = /incbin/("/lib/firmware/@@KERNEL_VERSION@@/device-tree/mediatek/camera-ap1302-ar1335-single.dtbo");
                        type = "flat_dt";
                        arch = "arm64";
                        compression = "none";
                        load = <0x44c00000>;
                        hash-1 {
                                algo = "sha256";
                        };
                };
                fdt-camera-ar0330-dual.dtbo {
                        description = "camera-ar0330-dual tree blob";
                        data = /incbin/("/lib/firmware/@@KERNEL_VERSION@@/device-tree/mediatek/camera-ar0330-dual.dtbo");
                        type = "flat_dt";
                        arch = "arm64";
                        compression = "none";
                        load = <0x44c00000>;
                        hash-1 {
                                algo = "sha256";
                        };
                };
                fdt-camera-ar0330-single.dtbo {
                        description = "camera-ar0330-single tree blob";
                        data = /incbin/("/lib/firmware/@@KERNEL_VERSION@@/device-tree/mediatek/camera-ar0330-single.dtbo");
                        type = "flat_dt";
                        arch = "arm64";
                        compression = "none";
                        load = <0x44c00000>;
                        hash-1 {
                                algo = "sha256";
                        };
                };
                fdt-panel-raspberrypi.dtbo {
                        description = "panel-raspberrypi tree blob";
                        data = /incbin/("/lib/firmware/@@KERNEL_VERSION@@/device-tree/mediatek/panel-raspberrypi.dtbo");
                        type = "flat_dt";
                        arch = "arm64";
                        compression = "none";
                        load = <0x44c00000>;
                        hash-1 {
                                algo = "sha256";
                        };
                };
                fdt-panel-urt-umo9465md.dtbo {
                        description = "panel-urt-umo9465md tree blob";
                        data = /incbin/("/lib/firmware/@@KERNEL_VERSION@@/device-tree/mediatek/panel-urt-umo9465md.dtbo");
                        type = "flat_dt";
                        arch = "arm64";
                        compression = "none";
                        load = <0x44c00000>;
                        hash-1 {
                                algo = "sha256";
                        };
                };
        };

        configurations {
                default = "conf-mt8183-pumpkin.dtb";
                conf-mt8183-pumpkin.dtb {
                        description = "Linux kernel, mt8183-pumpkin FDT blob";
                        kernel = "kernel-1";
                        ramdisk = "ramdisk-1";
                        fdt = "fdt-mt8183-pumpkin.dtb";
                        hash-1 {
                                algo = "sha256";
                        };
                };
                conf-camera-ap1302-ar0144-dual.dtbo {
                        description = "camera-ap1302-ar0144-dual FDT blob";
                        fdt = "fdt-camera-ap1302-ar0144-dual.dtbo";
                        hash-1 {
                                algo = "sha256";
                        };
                };
                conf-camera-ap1302-ar0144-single.dtbo {
                        description = "camera-ap1302-ar0144-single FDT blob";
                        fdt = "fdt-camera-ap1302-ar0144-single.dtbo";
                        hash-1 {
                                algo = "sha256";
                        };
                };
                conf-camera-ap1302-ar0330-dual-ar0144-dual.dtbo {
                        description = "camera-ap1302-ar0330-dual-ar0144-dual FDT blob";
                        fdt = "fdt-camera-ap1302-ar0330-dual-ar0144-dual.dtbo";
                        hash-1 {
                                algo = "sha256";
                        };
                };
                conf-camera-ap1302-ar0330-single-ar0144-dual.dtbo {
                        description = "camera-ap1302-ar0330-single-ar0144-dual FDT blob";
                        fdt = "fdt-camera-ap1302-ar0330-single-ar0144-dual.dtbo";
                        hash-1 {
                                algo = "sha256";
                        };
                };
                conf-camera-ap1302-ar0330-single-ar0144-single.dtbo {
                        description = "camera-ap1302-ar0330-single-ar0144-single FDT blob";
                        fdt = "fdt-camera-ap1302-ar0330-single-ar0144-single.dtbo";
                        hash-1 {
                                algo = "sha256";
                        };
                };
                conf-camera-ap1302-ar0330-single.dtbo {
                        description = "camera-ap1302-ar0330-single FDT blob";
                        fdt = "fdt-camera-ap1302-ar0330-single.dtbo";
                        hash-1 {
                                algo = "sha256";
                        };
                };
                conf-camera-ap1302-ar1335-single.dtbo {
                        description = "camera-ap1302-ar1335-single FDT blob";
                        fdt = "fdt-camera-ap1302-ar1335-single.dtbo";
                        hash-1 {
                                algo = "sha256";
                        };
                };
                conf-camera-ar0330-dual.dtbo {
                        description = "camera-ar0330-dual FDT blob";
                        fdt = "fdt-camera-ar0330-dual.dtbo";
                        hash-1 {
                                algo = "sha256";
                        };
                };
                conf-camera-ar0330-single.dtbo {
                        description = "camera-ar0330-single FDT blob";
                        fdt = "fdt-camera-ar0330-single.dtbo";
                        hash-1 {
                                algo = "sha256";
                        };
                };
                conf-panel-raspberrypi.dtbo {
                        description = "panel-raspberrypi FDT blob";
                        fdt = "fdt-panel-raspberrypi.dtbo";
                        hash-1 {
                                algo = "sha256";
                        };
                };
                conf-panel-urt-umo9465md.dtbo {
                        description = "panel-urt-umo9465md FDT blob";
                        fdt = "fdt-panel-urt-umo9465md.dtbo";
                        hash-1 {
                                algo = "sha256";
                        };
                };
        };
};
```

## usr/share/flash-kernel/its/image-zcu.its
```
/*
 * Simple U-Boot uImage source file containing a single kernel, ramdisk and FDT blob
 */

/dts-v1/;

/ {
    description = "Simple image with single Linux kernel, ramdisk and FDT blob";
    #address-cells = <1>;

    images {
        kernel-1 {
            description = "Ubuntu kernel";
            data = /incbin/("@@LINUX_IMAGE_FILE@@");
            type = "kernel";
            arch = "arm64";
            os = "linux";
            compression = "gzip";
            load = <0x00200000>;
            entry = <0x00200000>;
            hash-1 {
                algo = "sha1";
            };
        };

        ramdisk-1 {
            description = "Ubuntu ramdisk";
            data = /incbin/("@@INITRD_FILE@@");
            type = "ramdisk";
            arch = "arm64";
            os = "linux";
            compression = "none";
            hash-1 {
                algo = "sha1";
            };
        };
    };

    configurations {
        default = "conf-zcu-vck";
        conf-zcu-vck {
            description = "Boot Ubuntu on zcu/vck boards";
            kernel = "kernel-1";
            ramdisk = "ramdisk-1";
            hash-1 {
                algo = "sha1";
            };
        };
    };
};
```
